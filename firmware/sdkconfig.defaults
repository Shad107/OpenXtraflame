## firmware/sdkconfig.defaults
```kconfig
CONFIG_IDF_TARGET="esp32"

# Partition table
CONFIG_PARTITION_TABLE_CUSTOM=y
CONFIG_PARTITION_TABLE_CUSTOM_FILENAME="partitions.csv"
CONFIG_PARTITION_TABLE_FILENAME="partitions.csv"
CONFIG_PARTITION_TABLE_OFFSET=0x8000

# Flash size
CONFIG_ESPTOOLPY_FLASHSIZE_4MB=y
CONFIG_ESPTOOLPY_FLASHSIZE="4MB"
CONFIG_ESPTOOLPY_FLASHMODE_DIO=y
CONFIG_ESPTOOLPY_FLASHFREQ_40M=y

# Compiler
CONFIG_COMPILER_OPTIMIZATION_SIZE=y
CONFIG_LOG_DEFAULT_LEVEL_INFO=y

# FreeRTOS
CONFIG_FREERTOS_HZ=1000

# Wi-Fi
CONFIG_ESP_WIFI_SOFTAP_SUPPORT=y
CONFIG_ESP_WIFI_STATIC_RX_BUFFER_NUM=6
CONFIG_ESP_WIFI_DYNAMIC_TX_BUFFER_NUM=16

# lwIP
CONFIG_LWIP_MAX_SOCKETS=10

# Wi-Fi IRAM_OPT / RX_IRAM_OPT intentionally OFF: they were added in beta4 as
# part of the OTA-over-SoftAP fix bundle (=vTaskDelay yield + IRAM + suspend).
# On the ESP32-D0WDQ6 rev v1.0 shipped by Extraflame, forcing the Wi-Fi hot
# path into IRAM squeezes the layout enough to break STA reconnect after
# the first association => reason=210 loop reported by beta7..beta10 users.
# The vTaskDelay(1) in handle_ota_upload() alone is sufficient for STA-side
# OTA. Back to the beta5 baseline where Wi-Fi actually worked.

# CONFIG_SPI_FLASH_AUTO_SUSPEND is intentionally OFF: same bundle as above,
# requires ESP32 rev >= v3.0. Turning it on caused user-facing STA disconnect
# loops every ~5 s on beta4/beta5/beta6.

# HTTP server
CONFIG_HTTPD_MAX_REQ_HDR_LEN=1024
CONFIG_HTTPD_MAX_URI_LEN=256
```
